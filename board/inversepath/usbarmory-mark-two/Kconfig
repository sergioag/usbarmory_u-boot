## board/inversepath/usbarmory-mark-two/Kconfig
```kconfig
if TARGET_USBARMORY_MARK_TWO

choice
	prompt "DDR size"
	default SYS_DDR_512MB

config SYS_DDR_512MB
	bool "512 MB"

config SYS_DDR_1GB
	bool "1 GB"

endchoice

choice
	prompt "Boot device"
	default SYS_BOOT_DEV_MICROSD

config SYS_BOOT_DEV_MICROSD
	bool "micro SD"

config SYS_BOOT_DEV_EMMC
	bool "eMMC"

endchoice

choice
	prompt "Boot mode"
	default SYS_BOOT_MODE_NORMAL

config SYS_BOOT_MODE_NORMAL
	select DISTRO_DEFAULTS
	select ENV_IS_IN_MMC
	bool "Normal"

config SYS_BOOT_MODE_UMS
	bool "UMS"
	select ENV_IS_NOWHERE

config SYS_BOOT_MODE_TFTP
	bool "TFTP"
	select ENV_IS_NOWHERE

config SYS_BOOT_MODE_VERIFIED_OPEN
	bool "Verified Boot"
	select ENV_IS_NOWHERE

config SYS_BOOT_MODE_VERIFIED_LOCKED
	bool "Verified Boot and console disabled"
	select ENV_IS_NOWHERE

endchoice

config IMX_CONFIG
	default "board/inversepath/usbarmory-mark-two/imximage-512mb.cfg" if SYS_DDR_512MB
	default "board/inversepath/usbarmory-mark-two/imximage-1gb.cfg" if SYS_DDR_1GB

config SYS_MMC_ENV_DEV
	default 0 if SYS_BOOT_DEV_MICROSD
	default 1 if SYS_BOOT_DEV_EMMC

config SYS_MEMTEST_END
	default 0xa0000000 if SYS_DDR_512MB
	default 0xc0000000 if SYS_DDR_1G

config SYS_BOARD
	default "usbarmory-mark-two"

config SYS_VENDOR
	default "inversepath"

config SYS_CONFIG_NAME
	default "usbarmory-mark-two"

endif
```

## configs/usbarmory-mark-two_defconfig
```kconfig
CONFIG_ARM=y
CONFIG_ARCH_MX6=y
CONFIG_SYS_TEXT_BASE=0x87800000
CONFIG_TARGET_USBARMORY_MARK_TWO=y
CONFIG_MX6ULL=y

CONFIG_SYS_DDR_512MB=y
# CONFIG_SYS_DDR_1GB is not set

# Boot device
CONFIG_SYS_BOOT_DEV_MICROSD=y
# CONFIG_SYS_BOOT_DEV_EMMC is not set

# Environment
CONFIG_ENV_OFFSET=0x100000
CONFIG_ENV_SIZE=0x2000

# Boot mode
CONFIG_SYS_BOOT_MODE_NORMAL=y
# CONFIG_SYS_BOOT_MODE_UMS is not set
# CONFIG_SYS_BOOT_MODE_TFTP is not set
# CONFIG_SYS_BOOT_MODE_VERIFIED_OPEN is not set
# CONFIG_SYS_BOOT_MODE_VERIFIED_LOCKED is not set

CONFIG_NR_DRAM_BANKS=1
CONFIG_USE_BOOTCOMMAND=y
CONFIG_DOS_PARTITION=y
CONFIG_FSL_USDHC=y
CONFIG_SYS_MEMTEST_START=0x80000000

# Commands
CONFIG_CMD_DHCP=y
CONFIG_CMD_EXT2=y
CONFIG_CMD_FUSE=y
CONFIG_CMD_I2C=y
CONFIG_CMD_MEMTEST=y
CONFIG_CMD_MMC=y
CONFIG_CMD_PING=y
CONFIG_CMD_USB=y

# Device model support
CONFIG_DM=y
CONFIG_DM_MMC=y
CONFIG_DM_USB=y
CONFIG_DM_I2C=y
CONFIG_DM_GPIO=y
CONFIG_SYS_I2C_MXC=y
CONFIG_BLK=y
CONFIG_OF_LIBFDT=y
CONFIG_OF_CONTROL=y
CONFIG_OF_SEPARATE=y
CONFIG_DEFAULT_DEVICE_TREE="imx6ulz-usbarmory"

# Secure/Verified boot
CONFIG_FSL_CAAM=y
CONFIG_IMX_HAB=y
CONFIG_FIT=y
CONFIG_FIT_SIGNATURE=y
CONFIG_RSA=y

# USB gadgets
CONFIG_USB=y
CONFIG_CI_UDC=y
CONFIG_USB_GADGET=y
CONFIG_USB_GADGET_MANUFACTURER="FSL"
CONFIG_USB_GADGET_VENDOR_NUM=0x0525
CONFIG_USB_GADGET_PRODUCT_NUM=0xa4a5

# UMS gadget
CONFIG_USB_GADGET_DOWNLOAD=y
CONFIG_CMD_USB_MASS_STORAGE=y

# Ethernet gadget
CONFIG_USB_ETHER=y
CONFIG_USB_ETH_CDC=y

# TEE support
CONFIG_TEE=y
CONFIG_OPTEE=y
CONFIG_BOOTM_OPTEE=y
CONFIG_LEGACY_IMAGE_FORMAT=y
```
